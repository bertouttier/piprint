## Config.in
```kconfig
source "$BR2_EXTERNAL_PIPRINT_BUILDROOT_PATH/package/scanservjs/Config.in"
source "$BR2_EXTERNAL_PIPRINT_BUILDROOT_PATH/package/brlaser/Config.in"
```

## configs/piprint_defconfig
```kconfig
BR2_arm=y
BR2_arm1176jzf_s=y
BR2_SVN="svn"
BR2_PACKAGE_HOST_LINUX_HEADERS_CUSTOM_4_9=y
BR2_TOOLCHAIN_BUILDROOT_WCHAR=y
BR2_BINUTILS_VERSION_2_27_X=y
BR2_GCC_VERSION_5_X=y
BR2_TOOLCHAIN_BUILDROOT_CXX=y
BR2_SYSTEM_DHCP="eth0"
BR2_ROOTFS_OVERLAY="$(BR2_EXTERNAL_PIPRINT_BUILDROOT_PATH)/board/piprint/rootfs_overlay"
BR2_ROOTFS_POST_BUILD_SCRIPT="$(BR2_EXTERNAL_PIPRINT_BUILDROOT_PATH)/board/piprint/post-build.sh"
BR2_ROOTFS_POST_IMAGE_SCRIPT="$(BR2_EXTERNAL_PIPRINT_BUILDROOT_PATH)/board/piprint/post-image.sh"
BR2_LINUX_KERNEL=y
BR2_LINUX_KERNEL_CUSTOM_GIT=y
BR2_LINUX_KERNEL_CUSTOM_REPO_URL="https://github.com/raspberrypi/linux.git"
BR2_LINUX_KERNEL_CUSTOM_REPO_VERSION="5e4ee836560d4c0371e109bf469e1ad808ae7a44"
BR2_LINUX_KERNEL_DEFCONFIG="bcmrpi"
BR2_LINUX_KERNEL_DTS_SUPPORT=y
BR2_LINUX_KERNEL_INTREE_DTS_NAME="bcm2708-rpi-b bcm2708-rpi-b-plus bcm2708-rpi-cm"
BR2_PACKAGE_RPI_FIRMWARE=y
# BR2_PACKAGE_RPI_FIRMWARE_INSTALL_DTB_OVERLAYS is not set
BR2_PACKAGE_SANE_BACKENDS=y
BR2_PACKAGE_OPENSSL=y
BR2_PACKAGE_AVAHI=y
BR2_PACKAGE_AVAHI_DAEMON=y
BR2_PACKAGE_CUPS=y
BR2_PACKAGE_GUTENPRINT=y
BR2_TARGET_ROOTFS_EXT2=y
BR2_TARGET_ROOTFS_EXT2_4=y
BR2_TARGET_ROOTFS_EXT2_SIZE="200M"
# BR2_TARGET_ROOTFS_TAR is not set
BR2_PACKAGE_HOST_DOSFSTOOLS=y
BR2_PACKAGE_HOST_GENEXT2FS=y
BR2_PACKAGE_HOST_GENIMAGE=y
BR2_PACKAGE_HOST_MTOOLS=y
BR2_PACKAGE_BRLASER=y
```

## package/brlaser/Config.in
```kconfig
config BR2_PACKAGE_BRLASER
	bool "brlaser"
	depends on BR2_PACKAGE_CUPS
	help
	  Brother laser printer driver
	  https://github.com/pdewacht/brlaser
```

## package/phpsane/Config.in
```kconfig
config BR2_PACKAGE_PHPSANE
	bool "phpsane"
	help
	  PHPSane
	  https://sourceforge.net/projects/phpsane/
```

## package/scanservjs/Config.in
```kconfig
config BR2_PACKAGE_SCANSERVJS
	bool "ScanServJS"
  depends on BR2_PACKAGE_NODEJS
	help
	  NodeJS Web UI for SANE
	  https://github.com/sbs20/scanservjs.git
```
